## package/pin_shutdown/Config.in
```kconfig
config BR2_PACKAGE_PIN_SHUTDOWN
  bool "Shutdown on GPIO transition"
  depends on BR2_arm && BR2_PACKAGE_PYTHON
```

## package/pybus_rover/Config.in
```kconfig
config BR2_PACKAGE_PYBUS_ROVER
  bool "PyBus iBus interface for Rover P38"
  depends on BR2_arm && BR2_PACKAGE_PYTHON
```

## package/python-mpd/Config.in
```kconfig
config BR2_PACKAGE_PYTHON_MPD
  bool "MPD hooks for Python"
  depends on BR2_arm && BR2_PACKAGE_PYTHON
```

## package/python-rpigpio/Config.in
```kconfig
config BR2_PACKAGE_PYTHON_RPIGPIO
  bool "GPIO Python module for Raspberry Pi"
  depends on BR2_arm && BR2_PACKAGE_PYTHON
```
